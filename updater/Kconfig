## updater/Kconfig
```kconfig
# Application Kconfig.
#
# Until the MeshCore command interface there was nothing app-specific to
# declare here (everything came from prj.conf and board fragments), so this
# file did not exist. It must end by sourcing Kconfig.zephyr or none of
# Zephyr's own options are defined.

menu "MeshCore command interface"

config MC_CMD
	bool "MeshCore command interface over a Wio-SX1262"
	depends on SOC_NRF52840 && BT
	select FLASH
	select FLASH_MAP
	select GPIO
	select SPI
	select ENTROPY_GENERATOR
	help
	  Lets one configured MeshCore operator key arm, start and abort a DFU
	  and read status over LoRa. See updater/src/mc/ and MESHCORE.md.
	  Hardware: Seeed Wio-SX1262 on a XIAO nRF52840. Enable it with the
	  build wrapper (build-meshcore.sh), which also applies the devicetree
	  overlay that wires the radio.

if MC_CMD

config MC_CMD_ENFORCE
	bool "Refuse every DFU start that did not come from the MeshCore START path"
	default y
	help
	  With this on, dfu_runner_start() refuses (-EPERM) unless the MeshCore
	  controller is in START_AUTHORIZED and the caller is the thread it
	  authorised, with the exact bundle path and pin it authorised. That
	  closes the other ways a run can begin: auto_flash at boot and the SMP
	  TRIGGER_DFU command. Turn it off only on a bench, and note that "do
	  not begin DFU automatically" is then no longer guaranteed.

config MC_OPERATOR_PUBKEY
	string "Operator's MeshCore public key (64 hex characters)"
	default ""
	help
	  The only key whose messages are accepted. Empty means every command is
	  ignored. Put it in updater/boards/meshcore/operator.conf (git-ignored),
	  not in a file that is committed. It is compiled in on purpose: it must
	  not live on the filesystem, which any BLE client can rewrite over SMP.

config MC_NODE_NAME
	string "Name in the MeshCore advert"
	default "DroneUpd"

config MC_ADVERT_INTERVAL_S
	int "Seconds between adverts"
	default 21600
	range 600 604800
	help
	  Each advert writes a record to flash, and adverts use channel time.
	  The operator only needs one to add the node as a contact.

config MC_LAB
	bool "MeshCore lab logging"
	depends on MC_CMD
	help
	  Log MeshCore RX/TX frames, every BLE scan row handed to the controller,
	  the RSSI qualification line every 2 s while arming, DFU status changes
	  and the reset cause. Costs flash (log strings) and a little airtime of
	  the console; the production build leaves it off. State transitions and
	  command results are always logged (they are the audit trail).

config MC_LAB_KEEP_SCANNING
	bool "Lab: keep the BLE survey scan running while idle"
	depends on MC_LAB
	help
	  The survey scan normally stops 6 s after the last `scan`. With this
	  on, the mc thread restarts it every 3 s while IDLE so the BLE
	  coexistence test can run for 10 minutes without operator commands.
	  It does not start a DFU and is off in the `dfu` profile.

config MC_DFU_DRY_RUN
	bool "DFU dry run: run every check, never touch the target"
	depends on MC_CMD
	default y
	help
	  Every control path runs (ARM, BLE target match, RSSI qualification,
	  digest checks, START token, authorisation) but the DFU runner returns
	  before it scans, connects, erases or writes anything, and START
	  answers "DRY RUN PASS". Default y so that a build which does not
	  decide is the harmless one. A build that is meant to flash a target
	  must say CONFIG_MC_DFU_DRY_RUN=n explicitly (the `dfu` profile does,
	  and build-meshcore.sh refuses it unless MC_DISABLE_DRY_RUN=yes).

config MC_THREAD_STACK
	int "mc thread stack (bytes)"
	default 6144

comment "Update gate"

config MC_AVG_RSSI_MIN
	int "Minimum rolling-average RSSI of the armed target (dBm)"
	default -65
	range -120 -30
	help
	  START is refused unless the mean of the last 16 advertisements is at or
	  above this. Lab default; set it for the real link budget. All gate
	  values are build-time on purpose: anything read from the filesystem
	  could be rewritten by any BLE client over SMP, which would let the gate
	  be weakened from outside.

config MC_RSSI_FLOOR
	int "Hard RSSI floor (dBm)"
	default -75
	range -120 -30
	help
	  Any single advertisement below this restarts the acquisition. Must not
	  be above the average threshold.

config MC_GATE_HYST_DB
	int "Hysteresis once qualified (dB)"
	default 3
	range 0 20
	help
	  After the gate is ready, the rolling average may dip this far below the
	  average threshold before readiness is lost, so one slightly weak packet
	  does not flap the state.

config MC_GATE_HOLD_MS
	int "Acquisition duration (ms)"
	default 5000
	range 5000 120000
	help
	  The lower bound is the five seconds the requirement asks for.

config MC_GATE_MAX_GAP_MS
	int "Longest silence from the target during acquisition (ms)"
	default 3000
	range 500 10000

config MC_GATE_MIN_SAMPLES
	int "Fewest adverts during the acquisition"
	default 8
	range 2 100

config MC_ARM_TIMEOUT_S
	int "Seconds an ARM stays valid (0 = never)"
	default 60
	range 0 86400

config MC_TOKEN_TTL_S
	int "Seconds a single-use command token stays valid"
	default 120
	range 10 3600

config MC_REPORT_GAP_MS
	int "Minimum gap between unsolicited reports (ms)"
	default 4000
	range 1000 600000
	help
	  Progress reports are queued and sent no closer together than this, so a
	  DFU run never has LoRa traffic more often than every few seconds. A
	  newer milestone replaces a queued older one.

comment "Target identity"

config MC_TARGET_ALLOW_PLUS1
	bool "Accept the Nordic DFU-mode address (armed address + 1)"
	default y
	help
	  After a buttonless jump the bootloader advertises one address above the
	  application. Only accepted for a device that was seen in application
	  mode, and only with the DFU service UUID. See src/mc/mc_target.h.

config MC_TARGET_REQUIRE_DFU_UUID
	bool "Require the Nordic Legacy DFU service UUID at armed address + 1"
	default y

config MC_TARGET_DFU_NAME
	string "Expected DFU-mode advertised name (empty = do not check)"
	default "4631_DFU"
	help
	  A second check at armed address + 1, never the identity: a packet that
	  carries a different name is refused; a packet with no name (advertising
	  data and scan response are separate packets) is judged on the UUID.

comment "LoRa (defaults: MeshCore US preset)"

config MC_FREQ_HZ
	int "Frequency (Hz)"
	default 910525000

config MC_BW_HZ
	int "Bandwidth (Hz)"
	default 62500
	help
	  Must be one the SX126x has: 7810 10420 15630 20830 31250 41670 62500
	  125000 250000 500000.

config MC_SF
	int "Spreading factor"
	default 7
	range 5 12

config MC_CR
	int "Coding rate denominator (5 = 4/5)"
	default 5
	range 5 8

config MC_PREAMBLE
	int "Preamble symbols"
	default 16

config MC_SYNC_WORD
	hex "Sync word"
	default 0x12

config MC_TX_POWER_DBM
	int "TX power (dBm)"
	default 22
	range -9 22
	help
	  Do not transmit without an antenna fitted: the PA can be damaged.

config MC_OCP_MA
	int "Over-current protection (mA)"
	default 140

config MC_LBT_TRIES
	int "Channel-busy checks before sending anyway"
	default 6
	range 0 20

config MC_LBT_RSSI_DBM
	int "Channel counts as busy above (dBm)"
	default -85

endif # MC_CMD

endmenu

source "Kconfig.zephyr"
```
